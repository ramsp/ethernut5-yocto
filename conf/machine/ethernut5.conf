## conf/machine/ethernut5.conf
```bitbake
#@TYPE: Machine
#@NAME: Ethernut 5 Development Platform
#@DESCRIPTION: Machine configuration for the Ethernut 5 development board


PREFERRED_PROVIDER_virtual/kernel ?= "linux"
PREFERRED_VERSION_linux ?= "4.1.15"

KERNEL_IMAGETYPE = "fitImage"

KERNEL_DEVICETREE = "ethernut5.dtb"
KERNEL_EXTRA_ARGS += "LOADADDR=${UBOOT_ENTRYPOINT}"
KERNEL_CLASSES += " kernel-fitimage "

UBOOT_MACHINE = "ethernut5_config"

#don't try to access tty1
USE_VT = "0"

SERIAL_CONSOLE ?= "115200 ttyS0"


IMAGE_FSTYPES ?= "jffs2 tar.bz2"
EXTRA_IMAGECMD_jffs2 = "--pad --little-endian --eraseblock=0x80000 -n"

require conf/machine/include/tune-arm926ejs.inc
```

## meta-egnite/recipes-kernel/linux/ethernut5/kernel_fdt.its
```
/*
 * Simple U-boot uImage source file containing a single kernel and FDT blob
 */

/dts-v1/;

/ {
	description = "Simple image with single Linux kernel and FDT blob";
	#address-cells = <1>;

	images {
		fdt@1 {
			description = "Flattened Device Tree blob";
			data = /incbin/("./arch/arm/boot/dts/ethernut5.dtb");
			type = "flat_dt";
			arch = "arm";
			compression = "none";
			hash@1 {
				algo = "crc32";
			};
			hash@2 {
				algo = "sha1";
			};
		};
		kernel@1 {
			description = "Ethernut5 Linux kernel";
			data = /incbin/("./arch/arm/boot/zImage");
			type = "kernel";
			arch = "arm";
			os = "linux";
			compression = "none";
			load = <0x21000000>;
			entry = <0x21000000>;
			hash@1 {
				algo = "crc32";
			};
			hash@2 {
				algo = "sha1";
			};
		};
	};

	configurations {
		default = "conf@1";
		conf@1 {
			description = "Boot Linux kernel with FDT blob";
			kernel = "kernel@1";
			fdt = "fdt@1";
		};
	};
};
```
